## package/libretro-mpv/Config.in
```kconfig
config BR2_PACKAGE_LIBRETRO_MPV
        bool "libretro-mpv"
	depends on BR2_PACKAGE_RETROARCH
	depends on BR2_PACKAGE_MPV_LIB
        help
          A libretro core based on the mpv media player.

          https://github.com/deltabeard/libretro-mpv

comment "Libretro-mpv depends on libmpv"
	depends on !BR2_PACKAGE_MPV_LIB
```

## package/libretro-snes9x2002/Config.in
```kconfig
config BR2_PACKAGE_LIBRETRO_SNES9X2002
        bool "libretro-snes9x2002"
	depends on BR2_PACKAGE_RETROARCH
	depends on BR2_INSTALL_LIBSTDCPP
        help
		Snes9x 2002. Port of SNES9x 1.39 for libretro (was previously
		called PocketSNES). Heavily optimized for ARM.

		http://www.libretro.com

comment "LIBRETRO_POCKETSNES needs a toolchain w/ C++"
	depends on !BR2_INSTALL_LIBSTDCPP
```

## package/libretro_armsnes/Config.in
```kconfig
config BR2_PACKAGE_ARMSNES
        bool "libretro-armsnes"
	depends on BR2_PACKAGE_RETROARCH
	depends on BR2_PACKAGE_ZLIB
	depends on BR2_PACKAGE_LIBPNG
	depends on BR2_INSTALL_LIBSTDCPP
        help
          A libretro SNES emulator core for ARM.

	  http://www.libretro.com

comment "armsnes needs a toolchain w/ C++, zlib, and libpng"
	depends on !BR2_INSTALL_LIBSTDCPP && !BR2_PACKAGE_ZLIB \
		&& !BR2_PACKAGE_LIBPNG
```

## package/omxplayer/Config.in
```kconfig
config BR2_PACKAGE_OMXPLAYER
	bool "omxplayer"
	depends on BR2_TOOLCHAIN_BUILDROOT_GLIBC
	select BR2_PACKAGE_FFMPEG
	select BR2_PACKAGE_BOOST
	select BR2_PACKAGE_PCRE
#	select BR2_PACKAGE_LIBERATION
	select BR2_PACKAGE_FFMPEG_GPL
#	select BR2_PACKAGE_FFMPEG_AVFILTER
	select BR2_PACKAGE_FFMPEG_SWSCALE
	select BR2_PACKAGE_FFMPEG_POSTPROC
	select BR2_PACKAGE_DBUS
	select BR2_PACKAGE_ZLIB
	help
		Enables omxplayer (Media player backend
		for xbmc on Raspberry Pi)

comment "omxplayer requires glibc for input to work correctly with dbus"
	depends on !BR2_TOOLCHAIN_BUILDROOT_GLIBC
```

## package/retroarch-assets/Config.in
```kconfig
config BR2_PACKAGE_RETROARCH_ASSETS
        bool "retroarch-assets"
	depends on BR2_PACKAGE_RETROARCH
	help
	Assets needed for RetroArch. Also contains the official branding.

	http://www.libretro.com

config BR2_PACKAGE_RETROARCH_ASSETS_XMB_ONLY
	bool "retroarch-assets-xmb-only"
	depends on !BR2_PACKAGE_RETROARCH_ASSETS
	depends on BR2_PACKAGE_RETROARCH
	help
	Installs XMB theme assets for RetroArch only.

	http://www.libretro.com
```

## package/retroarch-joypad-autoconfig/Config.in
```kconfig
config BR2_PACKAGE_RETROARCH_JOYPAD_AUTOCONFIG
        bool "retroarch-joypad-autoconfig"
	depends on BR2_PACKAGE_RETROARCH
        help
          RetroArch joypad autoconfig files.

	  http://www.libretro.com
```

## package/retroarch/Config.in
```kconfig
config BR2_PACKAGE_RETROARCH
	depends on (BR2_PACKAGE_HAS_LIBGLES || BR2_PACKAGE_HAS_LIBEGL || BR2_PACKAGE_HAS_LIBGL)
        bool "Retroarch"
        help
          A multi emulator frontend.

	  http://www.libretro.com

if BR2_PACKAGE_RETROARCH
       source "package/retroarch-joypad-autoconfig/Config.in"
menu "Libretro Cores"
       source "package/libretro-armsnes/Config.in"
       source "package/libretro-fceumm/Config.in"
       source "package/libretro-fceunext/Config.in"
       source "package/libretro-gambatte/Config.in"
       source "package/libretro-genesisplusgx/Config.in"
       source "package/libretro-gpsp/Config.in"
       source "package/libretro-meteor/Config.in"
       source "package/libretro-mgba/Config.in"
       source "package/libretro-nestopia/Config.in"
       source "package/libretro-pcsx/Config.in"
       source "package/libretro-picodrive/Config.in"
       source "package/libretro-quicknes/Config.in"
       source "package/libretro-snes9x-next/Config.in"
       source "package/libretro-snes9x/Config.in"
       source "package/libretro-snes9x2002/Config.in"
       source "package/libretro-tgbdual/Config.in"
endmenu
endif

comment "Retroarch depends on EGL or OpenGLES"
	depends on !(BR2_PACKAGE_HAS_LIBEGL || BR2_PACKAGE_HAS_LIBGLES || BR2_PACKAGE_HAS_LIBGL)
```

## package/sdl2/Config.in
```kconfig
config BR2_PACKAGE_SDL2
	bool "SDL2"
	help
	  Simple DirectMedia Layer - SDL is a library that allows
	  programs portable low level access to a video framebuffer,
	  audio output, mouse, and keyboard.

	  http://www.libsdl.org/

if BR2_PACKAGE_SDL2

config BR2_PACKAGE_SDL2_RPI
	bool "SDL2 for Raspberry Pi"
	depends on BR2_PACKAGE_RPI_USERLAND
	depends on BR2_PACKAGE_HAS_LIBGLES
	depends on BR2_PACKAGE_EUDEV

config BR2_PACKAGE_SDL2_FBCON
	bool "SDL framebuffer console video driver"
	default y

config BR2_PACKAGE_SDL2_DIRECTFB
	bool "SDL DirectFB video driver"
	depends on BR2_PACKAGE_DIRECTFB

config BR2_PACKAGE_SDL2_QTOPIA
	bool "SDL Qtopia video driver"
	depends on BR2_PACKAGE_QT

config BR2_PACKAGE_SDL2_X11
	bool "SDL X11 video driver"
	depends on BR2_PACKAGE_XORG7
	select BR2_PACKAGE_XLIB_LIBX11
	select BR2_PACKAGE_XLIB_LIBXEXT

endif
```

## package/sdl_dispmanx/Config.in
```kconfig
config BR2_PACKAGE_SDL_DISPMANX
        bool "SDL_dispmanx"
	depends on BR2_PACKAGE_RPI_USERLAND
	depends on BR2_PACKAGE_HAS_LIBGLES
        help
          SDL 1 with rpi fixes / dispmanx

          https://github.com/joolswills/sdl1
```
